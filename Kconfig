## Kconfig
```kconfig
mainmenu "LinCLI Configuration"

# 引入 src 子目录的 Kconfig
source "src/Kconfig"

# 引入 tests 子目录的 Kconfig
source "tests/Kconfig"
```

## configs/full_test_defconfig
```kconfig
CONFIG_CLI_ENABLE_SCHEDULER_TICK_PRINT=y
CONFIG_CLI_ENABLE_DEMO_AUTO_CMD=y
CONFIG_CLI_ENABLE_DEMO_BOOL=y
CONFIG_CLI_ENABLE_DEMO_BUF_INSUFFICIENT=y
CONFIG_CLI_ENABLE_DEMO_CALLBACK=y
CONFIG_CLI_ENABLE_DEMO_CLI_VAR=y
CONFIG_CLI_ENABLE_DEMO_CONFLICTS=y
CONFIG_CLI_ENABLE_DEMO_DOUBLE=y
CONFIG_CLI_ENABLE_DEMO_ENV=y
CONFIG_CLI_ENABLE_DEMO_INIT_D=y
CONFIG_CLI_ENABLE_DEMO_INT=y
CONFIG_CLI_ENABLE_DEMO_INT_ARRAY=y
CONFIG_CLI_ENABLE_DEMO_KEY_INTERACTION=y
CONFIG_CLI_ENABLE_DEMO_LED=y
CONFIG_CLI_ENABLE_DEMO_LOG=y
CONFIG_CLI_ENABLE_DEMO_MOTOR=y
CONFIG_CLI_ENABLE_DEMO_REQUIRED=y
CONFIG_CLI_ENABLE_DEMO_SCOPE=y
CONFIG_CLI_ENABLE_DEMO_STRING=y
CONFIG_CLI_ENABLE_DEMO_WITH_BUF=y
```

## configs/lincli_defconfig
```kconfig
#
# LinCLI Core
#

#
# CLI Features
#
CONFIG_CLI_ENABLE_USER=y
CONFIG_CLI_ENABLE_ENV=y
CONFIG_CLI_ENABLE_VAR=y
CONFIG_CLI_ENABLE_ADVANCED_COMPLETION=y
CONFIG_CLI_ENABLE_HELP=y
CONFIG_CLI_ENABLE_CMD_CHAIN=y
CONFIG_CLI_ENABLE_AUTO_RUN=y
CONFIG_HISTORY_MAX=4
CONFIG_DISPLAY_MAX_COWS=50
# end of CLI Features

#
# Library & Memory
#
CONFIG_CLI_CMD_BUF_SIZE=128
CONFIG_CLI_MPOOL_COUNT=6
CONFIG_CLI_MPOOL_SIZE=128
# end of Library & Memory

#
# Init & Debug
#
# end of Init & Debug
# end of LinCLI Core

#
# Tests & Demos
#
# CONFIG_CLI_ENABLE_SCHEDULER_TICK_PRINT is not set

#
# Unit Tests
#
CONFIG_CLI_ENABLE_UNIT_TESTS=y
# end of Unit Tests

#
# Demo Commands
#
# CONFIG_CLI_ENABLE_DEMO_AUTO_CMD is not set
# CONFIG_CLI_ENABLE_DEMO_BOOL is not set
# CONFIG_CLI_ENABLE_DEMO_BUF_INSUFFICIENT is not set
# CONFIG_CLI_ENABLE_DEMO_CALLBACK is not set
# CONFIG_CLI_ENABLE_DEMO_CLI_VAR is not set
# CONFIG_CLI_ENABLE_DEMO_CONFLICTS is not set
# CONFIG_CLI_ENABLE_DEMO_DOUBLE is not set
# CONFIG_CLI_ENABLE_DEMO_ENV is not set
# CONFIG_CLI_ENABLE_DEMO_INIT_D is not set
# CONFIG_CLI_ENABLE_DEMO_INT is not set
# CONFIG_CLI_ENABLE_DEMO_INT_ARRAY is not set
# CONFIG_CLI_ENABLE_DEMO_KEY_INTERACTION is not set
# CONFIG_CLI_ENABLE_DEMO_LED is not set
# CONFIG_CLI_ENABLE_DEMO_LOG is not set
# CONFIG_CLI_ENABLE_DEMO_MOTOR is not set
# CONFIG_CLI_ENABLE_DEMO_REQUIRED is not set
# CONFIG_CLI_ENABLE_DEMO_SCOPE is not set
# CONFIG_CLI_ENABLE_DEMO_STRING is not set
# CONFIG_CLI_ENABLE_DEMO_WITH_BUF is not set
# end of Demo Commands
# end of Tests & Demos
```

## configs/mini_defconfig
```kconfig
# CONFIG_CLI_ENABLE_USER is not set
# CONFIG_CLI_ENABLE_ENV is not set
# CONFIG_CLI_ENABLE_VAR is not set
# CONFIG_CLI_ENABLE_ADVANCED_COMPLETION is not set
# CONFIG_CLI_ENABLE_HELP is not set
# CONFIG_CLI_ENABLE_CMD_CHAIN is not set
# CONFIG_CLI_ENABLE_AUTO_RUN is not set
# CONFIG_CLI_ENABLE_UNIT_TESTS is not set
```

## configs/tail_pr_and_cmd_test_defconfig
```kconfig
#
# LinCLI Core
#

#
# CLI Features
#
CONFIG_CLI_ENABLE_USER=y
CONFIG_CLI_ENABLE_ENV=y
CONFIG_CLI_ENABLE_VAR=y
CONFIG_CLI_ENABLE_ADVANCED_COMPLETION=y
CONFIG_CLI_ENABLE_HELP=y
CONFIG_CLI_ENABLE_CMD_CHAIN=y
CONFIG_CLI_ENABLE_AUTO_RUN=y
CONFIG_HISTORY_MAX=4
CONFIG_DISPLAY_MAX_COWS=50
# end of CLI Features

#
# Library & Memory
#
CONFIG_CLI_CMD_BUF_SIZE=128
CONFIG_CLI_MPOOL_COUNT=6
CONFIG_CLI_MPOOL_SIZE=128
# end of Library & Memory
# end of LinCLI Core

#
# Tests & Demos
#
CONFIG_CLI_ENABLE_SCHEDULER_TICK_PRINT=y
CONFIG_CLI_ENABLE_UNIT_TESTS=y

#
# Demo Commands
#
CONFIG_CLI_ENABLE_DEMO_AUTO_CMD=y
CONFIG_CLI_ENABLE_DEMO_BOOL=y
CONFIG_CLI_ENABLE_DEMO_BUF_INSUFFICIENT=y
CONFIG_CLI_ENABLE_DEMO_CALLBACK=y
CONFIG_CLI_ENABLE_DEMO_CLI_VAR=y
CONFIG_CLI_ENABLE_DEMO_CONFLICTS=y
CONFIG_CLI_ENABLE_DEMO_DOUBLE=y
CONFIG_CLI_ENABLE_DEMO_ENV=y
CONFIG_CLI_ENABLE_DEMO_INIT_D=y
CONFIG_CLI_ENABLE_DEMO_INT=y
CONFIG_CLI_ENABLE_DEMO_INT_ARRAY=y
CONFIG_CLI_ENABLE_DEMO_KEY_INTERACTION=y
CONFIG_CLI_ENABLE_DEMO_LED=y
CONFIG_CLI_ENABLE_DEMO_LOG=y
CONFIG_CLI_ENABLE_DEMO_MOTOR=y
CONFIG_CLI_ENABLE_DEMO_REQUIRED=y
CONFIG_CLI_ENABLE_DEMO_SCOPE=y
CONFIG_CLI_ENABLE_DEMO_STRING=y
CONFIG_CLI_ENABLE_DEMO_WITH_BUF=y
# end of Demo Commands
# end of Tests & Demos
```

## src/Kconfig
```kconfig
menu "LinCLI Core"

source "src/cli/Kconfig"
source "src/third_party/Kconfig"

endmenu
```

## src/cli/Kconfig
```kconfig
menu "CLI Features"

config CLI_ENABLE_USER
    bool "Enable user system"
    default y
    help
      Enable user management system.

config CLI_ENABLE_ENV
    bool "Enable environment variables"
    default y
    help
      Enable environment variable get/set.

config CLI_ENABLE_VAR
    bool "Enable variable system"
    default y
    help
      Enable internal variable get/set.

config CLI_ENABLE_ADVANCED_COMPLETION
    bool "Enable advanced tab completion"
    default y
    help
      Option completion, candidate values, highlight loop.
      If disabled, only basic prefix matching + list print remains.

config CLI_ENABLE_HELP
    bool "Enable help system (--help auto-generation)"
    default y

config CLI_ENABLE_CMD_CHAIN
    bool "Enable command chaining (&&)"
    default y

config CLI_ENABLE_AUTO_RUN
    bool "Enable auto-run commands (CLI_AUTO_CMD)"
    default y

config CLI_ENABLE_RAW_COMMAND
    bool "Enable raw argument commands"
    default n
    help
      Allow commands with argc/argv style handlers instead of option parsing.
      Useful for cp/mv-like commands.

config HISTORY_MAX
    int "Command history entries"
    default 4
    range 1 64
    help
      Embedded targets should keep this small.

config DISPLAY_MAX_COWS
    int "Max columns for tab completion display"
    default 50
    range 10 200
    help
      If your terminal window is narrower than this value,
      tab completion output may be truncated.

config CLI_CMD_BUF_SIZE
    int "Command argument shared buffer size"
    default 128
    range 64 1024
    help
      Increase this if you see "command argument missing bytes" errors.

config CLI_MPOOL_COUNT
    int "Memory pool block count"
    default 6
    range 1 32

config CLI_MPOOL_SIZE
    int
    default CLI_CMD_BUF_SIZE
    help
      Currently fixed equal to CLI_CMD_BUF_SIZE.

endmenu
```

## src/lib/Kconfig
```kconfig
menu "Library & Memory"

config CLI_CMD_BUF_SIZE
    int "Command argument shared buffer size"
    default 128
    range 64 1024
    help
      Increase this if you see "command argument missing bytes" errors.

config CLI_MPOOL_COUNT
    int "Memory pool block count"
    default 6
    range 1 32

config CLI_MPOOL_SIZE
    int
    default CLI_CMD_BUF_SIZE
    help
      Currently fixed equal to CLI_CMD_BUF_SIZE.

endmenu
```

## src/third_party/Kconfig
```kconfig
menu "Third-Party Components"

config LIST
	bool "Enable linked list (list.h)"
	default n
	help
	  Provides list_head, hlist_head, container_of macros.
	  Zero dependency, header-only library.

config WORKQUEUE
	bool "Enable MCU workqueue (based on list.h)"
	default n
	select LIST
	help
	  Simplified workqueue for MCU.
	  Supports delayed execution, FIFO scheduling.
	  Requires LIST to be enabled(auto).

config HEXDUMP
	bool "Enable hexdump memory dump command"
	default n
	help
	  Provides 'hexdump' command for embedded memory/flash debugging.
	  Supports configurable address range, bytes per line,
	  and ASCII output.

config HEXDUMP_MIN_ADDR
	hex "Default minimum valid address"
	depends on HEXDUMP
	default 0x08000000
	help
	  Lower bound of the valid address range.
	  Default to STM32F103C8T6 Flash start address.

config HEXDUMP_MAX_ADDR
	hex "Default maximum valid address"
	depends on HEXDUMP
	default 0x0800FFFF
	help
	  Upper bound of the valid address range.
	  Default to STM32F103C8T6 Flash end address (64KB).

config HEXDUMP_BYTES_PER_LINE
	int "Default bytes per line"
	depends on HEXDUMP
	default 16
	range 1 64
	help
	  Number of bytes printed on each line.

config HEXDUMP_MAX_LEN
	int "Maximum bytes per dump"
	depends on HEXDUMP
	default 256
	range 1 4096
	help
	  Maximum number of bytes allowed in a single hexdump command.

endmenu
```

## tests/Kconfig
```kconfig
menu "Tests & Demos"

config CLI_ENABLE_SCHEDULER_TICK_PRINT
    bool "Enable inline tail print test"
    default n
    help
      Enable inline tail print feature test for scheduler tick output.

source "tests/unit/Kconfig"
source "tests/commands/Kconfig"

endmenu
```

## tests/commands/Kconfig
```kconfig
menu "Demo Commands"

config CLI_ENABLE_DEMO_AUTO_CMD
    bool "Enable auto cmd demo"
    default n
    select CLI_ENABLE_AUTO_RUN
    help
      Register the auto_cmd demo command.

config CLI_ENABLE_DEMO_BOOL
    bool "Enable bool test demo"
    default n
    help
      Register the bool test demo command.

config CLI_ENABLE_DEMO_BUF_INSUFFICIENT
    bool "Enable buf insufficient test demo"
    default n
    help
      Register the buf insufficient test demo command.

config CLI_ENABLE_DEMO_CALLBACK
    bool "Enable callback test demo"
    default n
    help
      Register the callback test demo command.

config CLI_ENABLE_DEMO_CLI_VAR
    bool "Enable cli var test demo"
    default n
    depends on CLI_ENABLE_VAR
    help
      Register the cli var test demo command.

config CLI_ENABLE_DEMO_CONFLICTS
    bool "Enable conflicts test demo"
    default n
    help
      Register the conflicts test demo command.

config CLI_ENABLE_DEMO_DOUBLE
    bool "Enable double test demo"
    default n
    help
      Register the double test demo command.

config CLI_ENABLE_DEMO_ENV
    bool "Enable env test demo"
    default n
    depends on CLI_ENABLE_ENV
    help
      Register the env test demo command.

config CLI_ENABLE_DEMO_INIT_D
    bool "Enable init_d test demo"
    default n
    help
      Register the init_d test demo command.

config CLI_ENABLE_DEMO_INT
    bool "Enable int test demo"
    default n
    help
      Register the int test demo command.

config CLI_ENABLE_DEMO_INT_ARRAY
    bool "Enable int array test demo"
    default n
    help
      Register the int array test demo command.

config CLI_ENABLE_DEMO_KEY_INTERACTION
    bool "Enable key interaction test demo"
    default n
    help
      Register the key interaction test demo command.

config CLI_ENABLE_DEMO_LED
    bool "Enable led test demo"
    default n
    help
      Register the led test demo command.

config CLI_ENABLE_DEMO_LOG
    bool "Enable log test demo"
    default n
    help
      Register the log test demo command.

config CLI_ENABLE_DEMO_MOTOR
    bool "Enable motor test demo"
    default n
    help
      Register the motor test demo command.

config CLI_ENABLE_DEMO_REQUIRED
    bool "Enable required test demo"
    default n
    help
      Register the required test demo command.

config CLI_ENABLE_DEMO_SCOPE
    bool "Enable scope test demo"
    default n
    help
      Register the scope test demo command.

config CLI_ENABLE_DEMO_STRING
    bool "Enable string test demo"
    default n
    help
      Register the string test demo command.

config CLI_ENABLE_DEMO_WITH_BUF
    bool "Enable with buf test demo"
    default n
    help
      Register the with buf test demo command.

config CLI_ENABLE_DEMO_WORKQUEUE
    bool "Enable workqueue test demo"
    default n
    select WORKQUEUE
    help
      Register the wqtest demo command.

config CLI_ENABLE_DEMO_RAW_CMD
    bool "Enable raw command test demo"
    default n
    select CLI_ENABLE_RAW_COMMAND
    help
      Register the cp raw argument demo command.

config CLI_ENABLE_DEMO_RAW_CMD_ASYNC
    bool "Enable async raw command test demo"
    default n
    select CLI_ENABLE_RAW_COMMAND
    help
      Register the mv async raw argument demo command.

endmenu
```

## tests/unit/Kconfig
```kconfig
menu "Unit Tests"

config CLI_ENABLE_UNIT_TESTS
    bool "Enable Unity unit tests"
    default y
    help
      Build the Unity unit test executable (unit_tests).
      The tests are run automatically during 'make build' via ctest.

endmenu
```
